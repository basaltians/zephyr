## drivers/fuel_gauge/bq2742x/Kconfig
```kconfig
# Copyright (c) 2025 Basalte bv
#
# SPDX-License-Identifier: Apache-2.0

config FUEL_GAUGE_BQ2742X
	bool "BQ2742X Fuel Gauge"
	default y
	depends on DT_HAS_TI_BQ2742X_ENABLED
	select I2C
	help
	  Enable I2C-based driver for BQ2742X Fuel Gauge.
```

## drivers/hdlc_rcp_if/Kconfig.spi
```kconfig
# Configuration options for NXP HDLC RCP SPI communication Interface

# Copyright (c) 2025 Basalte bv
# SPDX-License-Identifier: Apache-2.0

config HDLC_RCP_IF_SPI
	bool "SPI HDLC interface for Zephyr Openthread RCP host"
	default y
	depends on DT_HAS_SPI_HDLC_RCP_IF_ENABLED

config OPENTHREAD_HDLC_RCP_IF_SPI_RX_BUFFER_SIZE
	int "Set HDLC RCP IF SPI RX buffer size"
	depends on HDLC_RCP_IF_SPI
	default 32
	range 0 2043
	help
	  RX buffer size for the OpenThread HDLC host SPI.
```

## dts/bindings/dsa/microchip,ksz8567.yaml
```yaml
# Copyright (c), 2024 Basalte bv
# SPDX-License-Identifier: Apache-2.0

description: |
  KSZ8567 7-Port ethernet switch with SPI interface

compatible: "microchip,ksz8567"

include: [microchip_dsa.yaml]
```

## dts/bindings/fuel-gauge/ti,bq27427x.yaml
```yaml
# Copyright (c) 2025 Basalte bv
#
# SPDX-License-Identifier: Apache-2.0

description: |
  Texas Instruments BQ27426/BQ27427 fuel gauge. For more info visit
  https://www.ti.com/product/BQ27426
  https://www.ti.com/product/BQ27427

compatible: "ti,bq2742x"

include: [i2c-device.yaml, fuel-gauge.yaml]
```
