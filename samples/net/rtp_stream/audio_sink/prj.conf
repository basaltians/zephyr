## CMakeLists.txt
```
# SPDX-License-Identifier: Apache-2.0

cmake_minimum_required(VERSION 3.20.0)
find_package(Zephyr REQUIRED HINTS $ENV{ZEPHYR_BASE})
project(rtp_audio_stream)

target_sources(app PRIVATE src/main.c)

if(CONFIG_SOC_FAMILY_NXP_IMXRT)
  # Relocate key networking stack components and L2 layer to ITCM
  zephyr_code_relocate(LIBRARY subsys__net__ip
    LOCATION "ITCM_TEXT" NOKEEP)
  zephyr_code_relocate(LIBRARY subsys__net
    LOCATION "ITCM_TEXT" NOKEEP)
  if(CONFIG_NET_L2_ETHERNET)
    zephyr_code_relocate(LIBRARY drivers__ethernet
      LOCATION "ITCM_TEXT" NOKEEP)
    zephyr_code_relocate(LIBRARY subsys__net__l2__ethernet
      LOCATION "ITCM_TEXT" NOKEEP)
  endif()
  if(CONFIG_RTP)
    zephyr_code_relocate(LIBRARY subsys__net__lib__rtp
      LOCATION "ITCM_TEXT" NOKEEP)
  endif()
  if(CONFIG_RTP_AUDIO_STREAM)
    zephyr_code_relocate(LIBRARY ..__aes67__subsys__audio_stream__rtp
      LOCATION "ITCM_TEXT" NOKEEP)
  endif()
endif()
```

## Kconfig
```
config RTP_AUDIO_STREAM_SAMPLE_SAMPLE_RATE
	int "RTP Audio Stream Sample Sample Rate"
	default 48000
	help
	  Sample rate of the rtp audio stream sample


config RTP_AUDIO_STREAM_SAMPLE_N_BLOCKS
	int "RTP Audio Stream Sample N Blocks"
	default 10
	help
	  Number of blocks inside the I2S memslab.
	  Advised to be at least twice RTP_AUDIO_STREAM_SAMPLE_JITTER_BUFFER_SIZE

config RTP_AUDIO_STREAM_SAMPLE_JITTER_BUFFER_SIZE
	int "RTP Audio Stream Sample Jitter Buffer Size"
	default 5
	help
	  Number of blocks that get buffered when playing the audio. Should be smaller than the
	  number of blocks in the memslab

choice RTP_AUDIO_STREAM_SAMPLE_PAYLOAD_DURATION
	prompt "Duration of the payload of 1 RTP packet"
	default RTP_AUDIO_STREAM_SAMPLE_PAYLOAD_DURATION_1MS
	help
	  Given stereo audio sampled at 48kHz

config RTP_AUDIO_STREAM_SAMPLE_PAYLOAD_DURATION_0_5MS
	bool "RTP Audio Stream Sample Payload Duration 0.5 ms"

config RTP_AUDIO_STREAM_SAMPLE_PAYLOAD_DURATION_1MS
	bool "RTP Audio Stream Sample Payload Duration 1 ms"

config RTP_AUDIO_STREAM_SAMPLE_PAYLOAD_DURATION_2MS
	bool "RTP Audio Stream Sample Payload Duration 2 ms"

config RTP_AUDIO_STREAM_SAMPLE_PAYLOAD_DURATION_3MS
	bool "RTP Audio Stream Sample Payload Duration 3 ms"

config RTP_AUDIO_STREAM_SAMPLE_PAYLOAD_DURATION_4MS
	bool "RTP Audio Stream Sample Payload Duration 4 ms"

config RTP_AUDIO_STREAM_SAMPLE_PAYLOAD_DURATION_5MS
	bool "RTP Audio Stream Sample Payload Duration 5 ms"

endchoice

config RTP_AUDIO_STREAM_SAMPLE_PAYLOAD_DURATION_US
	int
	default 500 if RTP_AUDIO_STREAM_SAMPLE_PAYLOAD_DURATION_0_5MS
	default 1000 if RTP_AUDIO_STREAM_SAMPLE_PAYLOAD_DURATION_1MS
	default 2000 if RTP_AUDIO_STREAM_SAMPLE_PAYLOAD_DURATION_2MS
	default 3000 if RTP_AUDIO_STREAM_SAMPLE_PAYLOAD_DURATION_3MS
	default 4000 if RTP_AUDIO_STREAM_SAMPLE_PAYLOAD_DURATION_4MS
	default 5000 if RTP_AUDIO_STREAM_SAMPLE_PAYLOAD_DURATION_5MS

config RTP_AUDIO_STREAM_SAMPLE_PAYLOAD_SIZE
	int
	default 144 if RTP_AUDIO_STREAM_SAMPLE_PAYLOAD_DURATION_0_5MS # 1 * 48 * 3
	default 288 if RTP_AUDIO_STREAM_SAMPLE_PAYLOAD_DURATION_1MS # 2 * 48 * 3
	default 576 if RTP_AUDIO_STREAM_SAMPLE_PAYLOAD_DURATION_2MS # 2 * 2 * 48 * 3
	default 864 if RTP_AUDIO_STREAM_SAMPLE_PAYLOAD_DURATION_3MS # 3 * 2 * 48 * 3
	default 1152 if RTP_AUDIO_STREAM_SAMPLE_PAYLOAD_DURATION_4MS # 4 * 2 * 48 * 3
	default 1440 if RTP_AUDIO_STREAM_SAMPLE_PAYLOAD_DURATION_5MS # 5 * 2 * 48 * 3
	help
	  Given stereo audio encoded with 24bit

config RTP_AUDIO_STREAM_SAMPLE_I2S_BLOCK_SIZE
	int
	default 192  if RTP_AUDIO_STREAM_SAMPLE_PAYLOAD_DURATION_0_5MS # 1 * 48 * 4
	default 384 if RTP_AUDIO_STREAM_SAMPLE_PAYLOAD_DURATION_1MS # 2 * 48 * 4
	default 768 if RTP_AUDIO_STREAM_SAMPLE_PAYLOAD_DURATION_2MS # 2 * 2 * 48 * 4
	default 1152 if RTP_AUDIO_STREAM_SAMPLE_PAYLOAD_DURATION_3MS # 3 * 2 * 48 * 4
	default 1536 if RTP_AUDIO_STREAM_SAMPLE_PAYLOAD_DURATION_4MS # 4 * 2 * 48 * 4
	default 1920 if RTP_AUDIO_STREAM_SAMPLE_PAYLOAD_DURATION_5MS # 5 * 2 * 48 * 4
	help
	  Given stereo audio sampled at 32bit (due to DMA limitations)

source "Kconfig.zephyr"
```

## prj.conf
```kconfig
CONFIG_AUDIO=y
CONFIG_AUDIO_CODEC=y
CONFIG_BZF=y
CONFIG_LOG=y
CONFIG_I2S=y
CONFIG_I2C=y
CONFIG_SHELL=y
CONFIG_REBOOT=y

CONFIG_MAIN_STACK_SIZE=4096
CONFIG_SYSTEM_WORKQUEUE_STACK_SIZE=4096
CONFIG_LOG_BUFFER_SIZE=4096

CONFIG_NETWORKING=y
CONFIG_NET_L2_ETHERNET=y
CONFIG_NET_IPV4=y
CONFIG_NET_IPV6=n
CONFIG_NET_TCP=n
CONFIG_NET_UDP=y
CONFIG_NET_SHELL=y

CONFIG_NET_IPV4_IGMP=y

CONFIG_NET_CONFIG_SETTINGS=y
CONFIG_NET_CONFIG_NEED_IPV4=y

CONFIG_NET_BUF_DATA_SIZE=1500
CONFIG_NET_RX_STACK_SIZE=4096

CONFIG_ZVFS_POLL_MAX=5

CONFIG_RTP=y
CONFIG_RTP_TRANSPORT_NET_PKT=y

CONFIG_RTP_STREAM=y

CONFIG_I2S_TX_BLOCK_COUNT=5

CONFIG_NET_LOG=y
CONFIG_RTP_LOG_LEVEL_DBG=y
CONFIG_RTP_STREAM_LOG_LEVEL_DBG=y
```

## ffmpeg.conf
```kconfig
# FFMPEG sends out the data in bursts. Sometimes, the interval between bursts can be over 50ms. We
# need to set our buffers large enough to handle these

CONFIG_NET_PKT_RX_COUNT=64
CONFIG_NET_BUF_RX_COUNT=64

CONFIG_I2S_TX_BLOCK_COUNT=128
CONFIG_RTP_AUDIO_STREAM_SAMPLE_N_BLOCKS=128
CONFIG_RTP_AUDIO_STREAM_SAMPLE_JITTER_BUFFER_SIZE=64
CONFIG_RTP_AUDIO_STREAM_RX_MSGQ_SIZE=128
```

## boards/aes67_devkit.conf
```kconfig
CONFIG_NET_DHCPV4=y
CONFIG_NET_CONFIG_AUTO_INIT=y

CONFIG_DMA=y
CONFIG_DMA_TCD_QUEUE_SIZE=4

CONFIG_CODE_DATA_RELOCATION=y
CONFIG_ETH_NXP_ENET_RX_BUFFERS=16
```

## boards/aes67_devkit.overlay
```dts
&enet_mac {
	local-mac-address = [02 04 9f b0 38 4f];
};
```

## src/main.c
```c
/* I2S muxer is deprecated, as we will move to the RT1176 that does not need it. Kept here for
completeness */
#define USE_I2S_MUXER 0

#if USE_I2S_MUXER
#include <basalte/drivers/i2s_muxer.h>
#endif
#include <zephyr/audio/codec.h>
#include <zephyr/device.h>
#include <zephyr/devicetree.h>
#include <zephyr/drivers/i2s.h>
#include <zephyr/logging/log.h>
#include <zephyr/net/rtp_stream.h>
#include <zephyr/net/net_if.h>
#include <zephyr/net/net_ip.h>

#define SINK_MCAST_ADDR "239.0.1.1"
#define SINK_MCAST_PORT 5004

LOG_MODULE_REGISTER(main);

RTP_STREAM_DEFINE_STATIC(my_audio_stream);

static const struct device *i2s_dev = DEVICE_DT_GET(DT_CHOSEN(basalte_i2s_out));
#if USE_I2S_MUXER
static const struct device *i2s_muxer_dev = DEVICE_DT_GET(DT_NODELABEL(sai1_muxer));
#endif
static const struct device *dac_dev = DEVICE_DT_GET(DT_CHOSEN(basalte_dac));

#define SAMPLE_RATE      CONFIG_RTP_AUDIO_STREAM_SAMPLE_SAMPLE_RATE
#define I2S_BLOCK_SIZE   CONFIG_RTP_AUDIO_STREAM_SAMPLE_I2S_BLOCK_SIZE
#define RTP_BLOCK_SIZE   CONFIG_RTP_AUDIO_STREAM_SAMPLE_PAYLOAD_SIZE
#define PAYLOAD_DURATION CONFIG_RTP_AUDIO_STREAM_SAMPLE_PAYLOAD_DURATION_US

/* Log every 5 seconds */
#define LOG_INTERVAL_BLOCKS (5000000U / PAYLOAD_DURATION)

#define N_BLOCKS           CONFIG_RTP_AUDIO_STREAM_SAMPLE_N_BLOCKS
#define JITTER_BUFFER_SIZE CONFIG_RTP_AUDIO_STREAM_SAMPLE_JITTER_BUFFER_SIZE

/* Timeout right before I2S buffer runs empty */
#define STREAM_TIMEOUT_US ((JITTER_BUFFER_SIZE - 2) * PAYLOAD_DURATION)

#define THREAD_STACK_SIZE 4096
#define THREAD_PRIO       85

struct sample_stream_state {
	enum {
		STATE_NOT_READY,
		STATE_READY,
		STATE_WAITING,
		STATE_BUFFERING,
		STATE_RUNNING,
		STATE_ERROR,
	} state;

	union {
		uint32_t jitter_buf_counter;
	};
};

static void audio_stream_thread_function(void *p1, void *p2, void *p3);
static struct rtp_stream_codec_api codec_api;
static void dac_configure_worker(struct k_work *work);

static struct sample_stream_state stream_state;

/* Can't use normal K_MEMSLAB_DEFINE, as caching fucks with it */
static char __nocache
	__aligned(WB_UP(32)) _k_mem_slab_buf_audio_slab[(N_BLOCKS)*WB_UP(I2S_BLOCK_SIZE)];
static STRUCT_SECTION_ITERABLE(k_mem_slab, audio_slab) = Z_MEM_SLAB_INITIALIZER(
	audio_slab, _k_mem_slab_buf_audio_slab, WB_UP(I2S_BLOCK_SIZE), N_BLOCKS);

#if USE_I2S_MUXER
/* Slab for the muxer — must always cover all I2S_MUXER_NUM_CHANNELS hardware lanes,
 * not just the active DT clients, so words_per_ch stays correct when some clients
 * are disabled in the overlay. */
static char __nocache __aligned(WB_UP(
	32)) _i2s_slab_buf_muxer[(N_BLOCKS)*WB_UP(I2S_MUXER_NUM_CHANNELS * I2S_BLOCK_SIZE)];
static STRUCT_SECTION_ITERABLE(k_mem_slab, i2s_slab_muxer) =
	Z_MEM_SLAB_INITIALIZER(i2s_slab_muxer, _i2s_slab_buf_muxer,
			       WB_UP(I2S_MUXER_NUM_CHANNELS *I2S_BLOCK_SIZE), N_BLOCKS);
#endif /* USE_I2S_MUXER */

K_THREAD_DEFINE(audio_stream_thread, THREAD_STACK_SIZE, audio_stream_thread_function, NULL, NULL,
		NULL, THREAD_PRIO, 0, 0);
K_WORK_DEFINE(dac_configure_work, dac_configure_worker);

static struct rtp_stream_config stream_config = {
	.block_size = RTP_BLOCK_SIZE,
	.codec_api = &codec_api,
	.mem_slab = &audio_slab,
	.transport_type = RTP_TRANSPORT_NET_PKT,
};

static K_SEM_DEFINE(rtp_configured, 0, 1);
static K_SEM_DEFINE(i2s_started, 0, 1);

static bool dacs_configured;

static void dac_configure_worker(struct k_work *work)
{
	int ret;

	if (dacs_configured) {
		return;
	}

	ret = audio_codec_configure(dac_dev, NULL);
	if (ret < 0) {
		LOG_ERR("Failed to configure dac (%d)", ret);
		return;
	}
	LOG_INF("Started DAC");

	dacs_configured = true;
}

static int codec_decode(void *data, size_t size, size_t *decoded_size, void *user_data)
{
	ARG_UNUSED(user_data);

	uint8_t *src = (uint8_t *)data + size - 3;
	uint8_t *dst = (uint8_t *)data + (4 * size) / 3 - 4;
	size_t n_samples = size / 3;
	uint8_t b0, b1, b2;

	for (size_t i = n_samples; i > 0; i--) {
		b0 = src[0];
		b1 = src[1];
		b2 = src[2];

		dst[3] = b0;
		dst[2] = b1;
		dst[1] = b2;
		dst[0] = 0x00;

		dst -= 4;
		src -= 3;
	}

	*decoded_size = n_samples * 4;

	return 0;
}

static struct rtp_stream_codec_api codec_api = {
	.decode = codec_decode,
};

static void audio_stream_thread_function(void *p1, void *p2, void *p3)
{
	struct i2s_config i2s_cfg;
	struct rtp_msg msg;
	int ret;

	/* Configure I2S stream */
	/* Actually 24, but dma can not handle this */
	i2s_cfg.word_size = 32U;
	i2s_cfg.channels = 2U;
	i2s_cfg.format = I2S_FMT_DATA_FORMAT_I2S;
	i2s_cfg.frame_clk_freq = SAMPLE_RATE;
	i2s_cfg.block_size = I2S_BLOCK_SIZE;
	i2s_cfg.timeout = STREAM_TIMEOUT_US / USEC_PER_MSEC;
	i2s_cfg.options = I2S_OPT_FRAME_CLK_CONTROLLER | I2S_OPT_BIT_CLK_CONTROLLER;
	i2s_cfg.mem_slab = &audio_slab;
	ret = i2s_configure(i2s_dev, I2S_DIR_TX, &i2s_cfg);
	if (ret < 0) {
		LOG_ERR("Failed to configure I2S stream\n");
		return;
	}
	LOG_INF("I2S configured");

	int counter = 0;
	while (true) {
		switch (stream_state.state) {
		case STATE_NOT_READY:
			/* Do nothing */
			k_msleep(10);
			break;
		case STATE_READY:
			ret = rtp_stream_trigger(&my_audio_stream, RTP_STREAM_START);
			if (ret < 0) {
				LOG_ERR("Failed to start rtp audio stream while ready (%d)", ret);
				stream_state.state = STATE_ERROR;
				break;
			}
			LOG_INF("Start RTP audio stream");

			stream_state.state = STATE_WAITING;
			break;
		case STATE_WAITING:
			LOG_INF("Waiting on first audio packet");

			ret = rtp_stream_read(&my_audio_stream, &msg, K_FOREVER);
			if (ret < 0) {
				LOG_ERR("Failed to read rtp audio stream while waiting (%d)", ret);
				stream_state.state = STATE_ERROR;
				break;
			}

			ret = i2s_write(i2s_dev, msg.data, msg.data_len);
			if (ret < 0) {
				LOG_ERR("Failed to write I2S while waiting (%d)", ret);
				k_mem_slab_free(&audio_slab, msg.data);
				stream_state.state = STATE_ERROR;
				break;
			}

			LOG_INF("Received first audio packet");

			stream_state.jitter_buf_counter = 1;
			stream_state.state = STATE_BUFFERING;
			break;
		case STATE_BUFFERING:
			if (stream_state.jitter_buf_counter++ == JITTER_BUFFER_SIZE) {
				ret = i2s_trigger(i2s_dev, I2S_DIR_TX, I2S_TRIGGER_START);
				if (ret < 0) {
					LOG_ERR("Failed to start I2S (%d)", ret);
					return;
				}

				LOG_INF("Started I2S transmitter");

				k_work_submit(&dac_configure_work);
				stream_state.state = STATE_RUNNING;
				break;
			}

			ret = rtp_stream_read(&my_audio_stream, &msg, K_MSEC(1000));
			if (ret < 0) {
				LOG_ERR("Failed to read rtp audio stream for buffer (%d)", ret);
				stream_state.state = STATE_ERROR;
				break;
			}

			ret = i2s_write(i2s_dev, msg.data, msg.data_len);
			if (ret < 0) {
				LOG_ERR("Failed to write I2S for buffer (%d)", ret);
				k_mem_slab_free(&audio_slab, msg.data);
				stream_state.state = STATE_ERROR;
				break;
			}

			break;
		case STATE_RUNNING:
			ret = rtp_stream_read(&my_audio_stream, &msg, K_USEC(STREAM_TIMEOUT_US));
			if (ret < 0) {
				LOG_ERR("Failed to read rtp audio stream during run (%d)", ret);
				stream_state.state = STATE_ERROR;
				break;
			}

			if (++counter % LOG_INTERVAL_BLOCKS == 0) {
				LOG_INF("Received %u blocks", LOG_INTERVAL_BLOCKS);
			}

			ret = i2s_write(i2s_dev, msg.data, msg.data_len);
			if (ret < 0) {
				LOG_ERR("Failed to write I2S for buffer during run (%d)", ret);
				k_mem_slab_free(&audio_slab, msg.data);
				stream_state.state = STATE_ERROR;
				break;
			}

			break;
		case STATE_ERROR:
			ret = i2s_trigger(i2s_dev, I2S_DIR_TX, I2S_TRIGGER_DROP);
			if (ret < 0) {
				LOG_ERR("Failed to drain I2S (%d)", ret);
			} else {
				LOG_WRN("Stopped I2S transmitter");
			}

			ret = rtp_stream_trigger(&my_audio_stream, RTP_STREAM_DROP);
			if (ret < 0) {
				LOG_ERR("Failed to stop rtp audio stream (%d)", ret);

				/* Retry again later */
				k_msleep(10);
				break;
			} else {
				LOG_WRN("Stopped RTP audio stream");
			}

			stream_state.state = STATE_READY;
			break;
		default:
			break;
		}
	}
}

int main(void)
{

	struct net_sockaddr_in sink_sockaddr_in;
	struct net_in_addr sink_in_addr;
	int ret;

	LOG_INF("Hello world from rtp audio stream sink sample!");

#if USE_I2S_MUXER
	/* Configure I2S muxer */
	struct i2s_config i2s_cfg;
	i2s_cfg.word_size = 32U;
	i2s_cfg.channels = 2U;
	i2s_cfg.format = I2S_FMT_DATA_FORMAT_I2S;
	i2s_cfg.frame_clk_freq = SAMPLE_RATE;
	i2s_cfg.block_size = BLOCK_SIZE;
	i2s_cfg.timeout = 50;
	i2s_cfg.options = I2S_OPT_FRAME_CLK_CONTROLLER | I2S_OPT_BIT_CLK_CONTROLLER;
	i2s_cfg.mem_slab = &i2s_slab_muxer;

	ret = i2s_muxer_configure(i2s_muxer_dev, I2S_DIR_TX, &i2s_cfg);
	if (ret < 0) {
		LOG_ERR("Failed to configure muxer (%d)", ret);
		return ret;
	}
#endif /* USE_I2S_MUXER */

	if (net_addr_pton(NET_AF_INET, SINK_MCAST_ADDR, &sink_in_addr) != 0) {
		LOG_ERR("Invalid address: %s", SINK_MCAST_ADDR);
		return -EINVAL;
	}

	sink_sockaddr_in.sin_family = NET_AF_INET;
	sink_sockaddr_in.sin_addr = sink_in_addr;
	sink_sockaddr_in.sin_port = net_htons(SINK_MCAST_PORT);

	stream_config.iface = net_if_get_default();
	stream_config.sock_addr = (struct net_sockaddr *)&sink_sockaddr_in;

	ret = rtp_stream_init(&my_audio_stream);
	if (ret < 0) {
		LOG_ERR("Failed to init audio stream (%d)", ret);
		return ret;
	}

	ret = rtp_stream_configure(&my_audio_stream, RTP_STREAM_ROLE_SINK, &stream_config);
	if (ret < 0) {
		LOG_ERR("Failed to configure rtp audio stream (%d)", ret);
		return ret;
	}

	stream_state.state = STATE_READY;

	LOG_INF("RTP audio stream ready");

	return 0;
}

BUILD_ASSERT(JITTER_BUFFER_SIZE > 2);
BUILD_ASSERT(CONFIG_RTP_AUDIO_STREAM_SAMPLE_JITTER_BUFFER_SIZE <= CONFIG_I2S_TX_BLOCK_COUNT);
BUILD_ASSERT(CONFIG_RTP_AUDIO_STREAM_SAMPLE_JITTER_BUFFER_SIZE <=
	     CONFIG_RTP_AUDIO_STREAM_SAMPLE_N_BLOCKS);
```
